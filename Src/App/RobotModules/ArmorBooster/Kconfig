## Src/App/RobotModules/ArmorBooster/Kconfig
```kconfig
menu "ArmorBooster config"
    depends on APP_USE_ARMORBOOSTER

    choice

        prompt "ArmorBooster type"
        default APP_USE_DUAL

        config APP_USE_DUAL
            bool "dual"
        config APP_USE_TRIP
            bool "trip"

    endchoice

    config ARMORBOOSTER_TYPE
        string
        default "DualFric" if APP_USE_DUAL
        default "TripFric" if APP_USE_TRIP

    config ARMORBOOSTER_FILE
        string
        default '"DualFric.hpp"' if APP_USE_DUAL
        default '"TripFric.hpp"' if APP_USE_TRIP

endmenu
```

## Src/Common/Extensions/TOF/Kconfig
```kconfig
menu "TOF config"
    depends on EXTENSION_TOF

    config TOF_TFMINIS
    bool "TFmini-S"
    default y

endmenu
```
